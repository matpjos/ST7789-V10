/*
 * tft.c
 *
 *  Created on: 24 Oct 2026
 *      Author: matpj
 */

#include "main.h"      /* SD_CS / TFT_CS pin names */
#include "spi.h"
#include "usart.h"
#include <stdio.h>
#include <string.h>
#include "tft.h"

#define MAX_SCALE  4

static uint8_t char_buf[6 * 8 * MAX_SCALE * MAX_SCALE * 2];   /* 1536 bytes */
static const uint8_t font5x7[95][5] = {
    {0x00,0x00,0x00,0x00,0x00}, {0x00,0x00,0x5F,0x00,0x00}, {0x00,0x07,0x00,0x07,0x00}, {0x14,0x7F,0x14,0x7F,0x14}, // sp ! " #
    {0x24,0x2A,0x7F,0x2A,0x12}, {0x23,0x13,0x08,0x64,0x62}, {0x36,0x49,0x56,0x20,0x50}, {0x00,0x05,0x03,0x00,0x00}, // $ % & '
    {0x00,0x1C,0x22,0x41,0x00}, {0x00,0x41,0x22,0x1C,0x00}, {0x14,0x08,0x3E,0x08,0x14}, {0x08,0x08,0x3E,0x08,0x08}, // ( ) * +
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    {0x00,0x00,0x7F,0x00,0x00}, {0x00,0x41,0x36,0x08,0x00}, {0x10,0x08,0x08,0x10,0x08}                              // | } ~
};


static void tft_cmd(uint8_t cmd, const uint8_t *data, uint16_t len);
static void tft_fill_rect(uint16_t x, uint16_t y, uint16_t w, uint16_t h, uint16_t colour);
static void tft_set_window(uint16_t x0, uint16_t y0, uint16_t x1, uint16_t y1);
static void tft_draw_char(uint16_t x, uint16_t y, const uint8_t *glyph, uint16_t fg, uint16_t bg, uint8_t scale);
static void tft_write(uint8_t dc, const uint8_t *buf, uint16_t len);



/* function to send command
 * DC=low; then send command
 * then send parameters if any */
static void tft_cmd(uint8_t cmd, const uint8_t *data, uint16_t len)
{
    tft_write(0, &cmd, 1);
    if (len) tft_write(1, data, len);
}



/* function to sent a buffer of data
 * DC --> toggle DC. SET for data, RESET for command.
 * CS --> LOW to select display
 * use SPI to transmit HAL
 * Then release CS pin to de-select. */
static void tft_write(uint8_t dc, const uint8_t *buf, uint16_t len)
{
    HAL_GPIO_WritePin(TFT_DC_GPIO_Port, TFT_DC_Pin, dc ? GPIO_PIN_SET : GPIO_PIN_RESET);
    HAL_GPIO_WritePin(TFT_CS_GPIO_Port, TFT_CS_Pin, GPIO_PIN_RESET);
    HAL_SPI_Transmit(&hspi1, (uint8_t *)buf, len, 100);
    HAL_GPIO_WritePin(TFT_CS_GPIO_Port, TFT_CS_Pin, GPIO_PIN_SET);
}




/*run init sequence:
 * RST LOW for 10ms; high for 120ms (pulsing RST) wait for display wake up */
void tft_init(void)
{
    HAL_GPIO_WritePin(TFT_RST_GPIO_Port, TFT_RST_Pin, GPIO_PIN_RESET);
    HAL_Delay(10);
    HAL_GPIO_WritePin(TFT_RST_GPIO_Port, TFT_RST_Pin, GPIO_PIN_SET);
    HAL_Delay(120);

    tft_cmd(0x01, NULL, 0);            HAL_Delay(150);  // software reset
    tft_cmd(0x11, NULL, 0);            HAL_Delay(120);  // sleep out
    tft_cmd(0x3A, (uint8_t[]){0x55}, 1);                // 16-bit colour (RGB565); (uint8_t[]){0x55} is a compound literal: an unnamed one-byte array made in-line, so you don't need a separate variable for a single parameter.
    tft_cmd(0x36, (uint8_t[]){0x60}, 1);                // MADCTL: landscape
    tft_cmd(0x21, NULL, 0);                             // inversion on (needed for this IPS)
    tft_cmd(0x13, NULL, 0);            HAL_Delay(10);   // normal mode
    tft_cmd(0x29, NULL, 0);            HAL_Delay(120);  // display on
}



/* set boundaries
 * call RASET, CASET commands
 * full screen fill*/
void tft_fill(uint16_t colour)
{
	tft_fill_rect(0, 0, TFT_W, TFT_H, colour);
}


static void tft_set_window(uint16_t x0, uint16_t y0, uint16_t x1, uint16_t y1)
{
    uint8_t xa[4] = { x0 >> 8, 	// Shifts the bits right by 8, leaving only the upper byte
    		x0 & 0xFF, 			// Masks off everything except the lower 8 bits
    		x1 >> 8, x1 & 0xFF  // same technique; because each coordinate is 16 bits, but SPI sends one byte at a time, so the code splits it into a high byte and a low byte
    };
    uint8_t ya[4] = { y0 >> 8, y0 & 0xFF, y1 >> 8, y1 & 0xFF }; // same method of making xa[] above
    uint8_t ramwr = 0x2C;

    /* Why a split is needed:
     * The ST7789 expects four bytes for each window command (0x2A columns, 0x2B rows)
     * 0x2A for columns; 0x2B for rows
     * 0x2A	CASET (Column Address Set)
     * 0x2B	RASET (Row Address Set)
     * 0x2C	RAMWR (Memory Write) --> Pixel data follows*/
    tft_cmd(0x2A, xa, 4);
    tft_cmd(0x2B, ya, 4);
    tft_write(0, &ramwr, 1);      // pixels follow
}


static void tft_fill_rect(uint16_t x, uint16_t y, uint16_t w, uint16_t h, uint16_t colour)
{
    if (w == 0 || h == 0 || x >= TFT_W || y >= TFT_H) return;
    if (x + w > TFT_W) w = TFT_W - x;        // clip to the screen
    if (y + h > TFT_H) h = TFT_H - y;

    tft_set_window(x, y, x + w - 1, y + h - 1);   // end coordinates are inclusive

    uint8_t buf[512];
    for (int i = 0; i < 512; i += 2) { buf[i] = colour >> 8; buf[i + 1] = colour & 0xFF; }

    uint32_t remaining = (uint32_t)w * h * 2;     // 2 bytes per pixel
    HAL_GPIO_WritePin(TFT_DC_GPIO_Port, TFT_DC_Pin, GPIO_PIN_SET);
    HAL_GPIO_WritePin(TFT_CS_GPIO_Port, TFT_CS_Pin, GPIO_PIN_RESET);
    while (remaining) {
        uint16_t n = remaining > 512 ? 512 : remaining;
        HAL_SPI_Transmit(&hspi1, buf, n, 100);
        remaining -= n;
    }
    HAL_GPIO_WritePin(TFT_CS_GPIO_Port, TFT_CS_Pin, GPIO_PIN_SET);
}




static void tft_draw_char(uint16_t x, uint16_t y, const uint8_t *glyph, uint16_t fg, uint16_t bg, uint8_t scale)
{
    if (scale < 1) scale = 1;
    if (scale > MAX_SCALE) scale = MAX_SCALE;

    uint16_t w = 6 * scale;
    uint16_t h = 8 * scale;

    /* Skip characters that don't fit entirely on screen */
    if (x + w > TFT_W || y + h > TFT_H) return;

    uint16_t i = 0;
    for (uint16_t oy = 0; oy < h; oy++) {
        uint8_t row = oy / scale;
        for (uint16_t ox = 0; ox < w; ox++) {
            uint8_t col = ox / scale;
            uint8_t lit = (col < 5) && ((glyph[col] >> row) & 1);
            uint16_t colour = lit ? fg : bg;
            char_buf[i++] = colour >> 8;
            char_buf[i++] = colour & 0xFF;
        }
    }

    tft_set_window(x, y, x + w - 1, y + h - 1);
    tft_write(1, char_buf, i);
}



/*x-Axis coordinates, Y-Axis coordinates, String, FG, BG, text-scale*/
void tft_draw_string (uint16_t x, uint16_t y, const char *s, uint16_t fg, uint16_t bg, uint8_t scale)
{
    if (scale < 1) scale = 1;
    if (scale > MAX_SCALE) scale = MAX_SCALE;

    uint16_t start_x = x;

    for (; *s; s++) { //tried while loop in the V2 version. this one with for loop.
        char c = *s;
        if (c < 32 || c > 126) c = '?';        /* keep font5x7 index in range */

        if (x + 6 * scale > TFT_W) {           /* wrap on scaled width */
            x = start_x;
            y += 8 * scale;
        }
        tft_draw_char(x, y, font5x7[c - 32], fg, bg, scale);
        x += 6 * scale;
    }
}
